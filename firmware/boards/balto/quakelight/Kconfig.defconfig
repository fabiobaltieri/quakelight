## firmware/boards/balto/quakelight/Kconfig.defconfig
```kconfig
if BOARD_QUAKELIGHT

if NETWORKING

config NET_L2_ETHERNET
	default y

endif

endif
```

## firmware/boards/balto/quakelight/board.yml
```yaml
board:
  name: quakelight
  full_name: QuakeLight
  vendor: st
  socs:
    - name: stm32h573xx
```
